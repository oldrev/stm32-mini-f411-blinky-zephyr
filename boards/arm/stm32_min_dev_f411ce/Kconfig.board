## boards/arm/stm32_min_dev_f411ce/Kconfig.board
```kconfig
# stm32-mini-f411-blinky-zephyr board configuration

# Copyright (c) 2020 Li Wei.
# SPDX-License-Identifier: Apache-2.0

config BOARD_STM32_MIN_DEV_F411CE
	bool "STM32 Mini Development F411CE Board"
	depends on SOC_STM32F411XE
```

## boards/arm/stm32_min_dev_f411ce/Kconfig.defconfig
```kconfig
# BBC LWM01 board configuration

# Copyright (c) 
# Copyright (c) 
# SPDX-License-Identifier: Apache-2.0

if BOARD_STM32_MIN_DEV_F411CE

config BOARD
	default "stm32_min_dev_f411ce"

config SPI_STM32_INTERRUPT
	default y
	depends on SPI

if WATCHDOG

config WWDG_STM32
	default y

config IWDG_STM32
	default n

endif # WATCHDOG

endif # BOARD_NUCLEO_F401RE
```
